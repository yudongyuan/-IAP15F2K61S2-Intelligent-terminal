//1.插入头文件  右键第二个便可以插入头文件
//2.tim模块的编写 初始化函数 led display函数 定时器T1初始化 3个
//3.seg模块的编写  Seg_Tran Seg_Disp 2个
//4.key模块的编写  Key_Read 1个
//5.调用写的头文件
//6.编写主程序模块 1.申明变量
//！！！！！所有的变量名称全部使用X_X的形式，以防和已被定义的名称重合！！！！！
// 3月15日进行降重处理
//  处理内容包括将所有常用变量写为X_X的形式 其中 O 一律代表old 
// U - UP D - Delay B - Buf V - Value C - Code 所有Proc 改为Proceed

//================================常见困难=========================
//温度模块
//温度模块中经常会发现温度突然读到一个错很多的值。并且当定时器中加入一些需要快速反映的
//函数变化时，会打乱温度的读数，造成错误的结果。
//解决方案：
//    if((Seg_Tem/16.0)<100)
//		{
//		    Keep_Tem=Seg_Tem/16.0;
//		}
//		else
//		{
//		    Seg_Tem=Keep_Tem*16;//对温度进行凝固处理，这样的处理方式可以使得消除读错的情况
//		}//使得功能表现更好，但缺点是会减低温度刷新频率。在比赛中要权衡哪一个分值会更高。
//		sprintf(S_B,"C   %4.2f",Seg_Tem/16.0);
//================================常见困难=========================


#include <STC15F2K60S2.H>
#include "tim.h"
#include "seg.h"
#include "key.h"
#include "stdio.h"//使用sprintf必备
#include "iic.h"
#include "onewire.h"
#include "ds1302.h"
#include "uart.h"
unsigned char K_V,K_O,K_U,K_D;
unsigned char S_B[10],S_C[8]={0xff,0xff,0xff,0xff,0xff,0xff,0xff,0xff},S_P,Led_V;
unsigned int S_Dly;
unsigned long ulms;//数码管的延时必须是int或long类型的
//====================================ds1302时钟模块==================================
//unsigned char pucRtc[3] = {23,59,50};//时钟初值
//====================================ds1302时钟模块==================================
//====================================串口通信专用数组================================
//unsigned char xdata Uart_Buf[12];//串口通信可以用xdata来防止内存过多
//unsigned char Uart_Num;
//====================================串口通信专用数组================================
//========================================超声波模块=================================
//unsigned char D_Dist;//超声波接收变量
//========================================超声波模块=================================
//========================================温度模块================================================
//unsigned char temp;//当不需要小数的时候温度读取只需要七位就行，所以这块用uc
//unsigned int uiTemp;//当需要小数时有11位所以需要ui
//========================================温度模块================================================
//========================================AD模块================================================
//unsigned char Adc_Val;
//
//========================================AD模块================================================
void Key_Proceed(void);
void Seg_Proceed(void);
void Led_Proceed(void);
void Uart_Proceed(void);



void Key_Proceed()
{
	
  if(K_Dly) return;//注意这里Key_Dly是不要加！的
	K_Dly =1;
	
	K_V=Key_Read();
	K_D=K_V&(K_O^K_V);
	K_U=~K_V&(K_O^K_V);
	K_O=K_V;
//======================================EEPROM写====================================
//	S_B[0]=Cha_Cou>>8;
//	S_B[1]=Cha_Cou&0xff;
//	EEPROM_Write(S_B,0,2);
//======================================EEPROM写====================================
//=======================================长按键===================================
//	if(K_D)//判断记录按下时间
//	{		
//	  Key_Time = ulms;
//		Key_Long = 0;
//	}
//	if(ulms-Key_Time<1000)
//	{
//		switch(K_D)
//  	{
//		}
//	}
//	else
//	{
//	  if((K_O == 12) && !Key_Long)//并且有键按下后才能有一次长按键，K_O代表按键值
//		{
//		  Key_Long=1;
//			Cha_Cou=0;
//		}
//	  if((K_O == 13) && !Key_Long)
//		{
//		  Key_Long=1;
//			Dac_Sta=!Dac_Sta;
//		}
//	}
//=======================================长按键===================================
//=======================================按下按键显示放开不显示=================================
//	if(Tim_Flag==0&&Sel_Mod==0)//界面进入判断
//		{
//		  if(K_O==4)//若S4被持续按下
//			{
//			  sprintf(S_B,"     %2uC",(unsigned int)(Tem_Val/16));
//				Tem_flag=1;//控制暂时关闭其他页面
//			}
//			else//反之
//			{
//				Tem_flag=0;//重新打开其他页面
//			}
//		}
//=======================================按下按键显示放开不显示=================================
//=======================================显示选中闪烁================================================
//完美闪烁办法
//	switch(Key_Down)
//	{
//	  case 4: 
//			if(++model==2)
//			{
//			  model=0;
//			}
//		break;
//		case 5: 
//      if(model==1)
//     {
//		   C_light=0;//在按键处清零计数时间
//			 if(++C_Q==2)
//		   C_Q=0;
//		 }
//		break;
//=======================================显示选中闪烁================================================
}

void Seg_Proceed()
{
	if(S_Dly) return;//注意这里Sey_Dly是不要加！的
	S_Dly = 1;
//=======================================seg模块====================================
//sprintf(S_B,"%02d",xx)与	sprintf(S_B,"%2d",xx)  前着是左边不够补0后者是左边不够补空格（即熄灭seg）
//在温度中尤其注意若题目要求数位不够熄灭seg时要以%2d的形式 熄灭seg
//其次尤其要注意Sprintf(S_B,"%2.1f",xx)
//%2.1代表的是两位宽！！但是这个位宽是包括小数点和小数的，意味着写位宽时应该考虑清楚小数点和整数和小数的总个数
//将此总个数作为位宽。其次如%5.1f若不满5位则默认右对齐，若要求左对齐则%-5.1f
//其次要注意若%x.1f x值小于本数值总个数会默认补全整数个数同时保留一位小数
//
//=======================================seg模块====================================
//=======================================ds1302时钟模块==============================
//	 Read_RTC(pucRtc);
//   if((pucRtc[0]==pucAlarm[0]) && (pucRtc[1]==pucAlarm[1])&& (pucRtc[2]==pucAlarm[2]));
//   
//=======================================ds1302时钟模块==============================
//=======================================频率模块=======================================
//sprintf(S_B,"HF %5u",(unsigned int)Flu_Val);
//=======================================频率模块=======================================
//========================================AD模块================================================
//  Adc_Val=PCF8591_Adc();
//
//========================================AD模块================================================
//========================================超声波模块=================================
//	ucDist = Wave_Recv();//接收超声波数据
//  sprintf(ucSeg_Buf, "2    %03u", (unsigned int)ucDist);//直接显示
//========================================超声波模块=================================
//=======================================显示选中闪烁================================================
//用一个大标志位控制两种不同的显示，然后分别挖去闪烁的位，在定时器中定时1600ms
//当大于800时暗下.细节在于完美选中需要在按键处对闪烁时间计数清零
//	if(C_Q==0)
//		{
//			if(C_light>=800)
//		  sprintf(Seg_Buf,"P  %2u   ",(unsigned int)T_Max);
//		  else
//	    sprintf(Seg_Buf,"P  %2u %2u",(unsigned int)T_Max,(unsigned int)T_Min);
//	  }
//		else
//		{
//		  if(C_light>=800)
//			sprintf(Seg_Buf,"P     %2u",(unsigned int)T_Min);
//		  else
//	    sprintf(Seg_Buf,"P  %2u %2u",(unsigned int)T_Max,(unsigned int)T_Min);
//		}
//=======================================显示选中闪烁================================================
//========================================温度模块================================================
//
//整数温度读取部分，整数类的要在数码管显示区进行赋值，去除小数后直接放入七位的温度内，用ui显示
//！！！！！！注意如果用慢显示的方式来消除85就要使得temp = Read_Tem()>>4;uiTemp = rd_temperature();
//语句在if(ulms>750)后面，在之前的话会导致读数紊乱
//temp = Read_Tem()>>4;！！看注意！！
//sprintf(Seg_Buf,"C     %2u",(unsigned int)temp);//用模板内的函数必须让取得的值先去掉小数点
//小数温度读取部分，
//uiTemp = rd_temperature();！！看注意！！//小数取出来放入ui类型的变量，由于5符号位  7整数位 4小数位 所以需要至少11位
//sprintf(pucSeg_Buf, "2   %04.2f", uiTemp/16.0);//除以16.0自动转换成float类型，所要用%f来表示
	
//========================================温度模块================================================
//========================================DA转换方法与检验方法=====================================
//PCF8591_Dac(204);//DA输入为uc类型的值即 0-255  51代表1V 102代表2V   ！！但是是有误差的，需要根据实践来测量微调给的值！！
//检验方法：使用万用表20V直流量程档 测量位于板子右下角的PCF8951芯片的右边第2个端口 (即15引脚，代表DA输出)
//实践细节：万用表红表笔接PCF8951芯片的右边第2个端口，黑表笔接最右边的GND即可
//========================================DA转换方法与检验方法=====================================
//========================================AD模块================================================
//  sprintf(S_B,"U    %03.2f",Adc_Val/51.0);//要小数就除以51.0不要就除以51
//========================================AD模块================================================
		Seg_Tran(S_B,S_C);
}

void Led_Proceed()
{
//========================================Led显示模块================================================
//	 Led_V=Led_V|0x01;//点亮第一个灯
//		Led_V=Led_V&(~0x02);//熄灭第二个灯
//		Led_V=Led_V&(~0x04);
//========================================Led显示模块================================================
}
//=======================================频率模块=======================================
//!!!!!注意当频率模块和超声波模块同时出现时，定时器T0将会被两个模块同时选择要注意区别他们
//若出现*** ERROR L104: MULTIPLE PUBLIC DEFINITIONS这样的报错说明被重复定义了T0定时器。
//void Timer0Init(void)			// 16位计数器模式 555频率计数专用
//{
//  AUXR &= 0x7F;						// 定时器时钟12T模式
//  TMOD |= 5;						// 设置16位计数器模式
//  TL0 = 0;							// 设置计数初值
//  TH0 = 0;							// 设置计数初值
//  TF0 = 0;							// 清除TF0标志
//  TR0 = 1;							// 开始计数
//}
//=======================================频率模块=======================================
//=====================================串口通信模块==============================
//void Uart_Proc()
//{	if(S_S) return;//串口也可以加延时防止发送过快导致的错误
//	S_S= 1;
//	if(Uart_Num>0)
//	{
//    if(Uart_Buf[Uart_Num-1] == 0xa&&Uart_Buf[Uart_Num-2] == 0xd)
//   0xd 13 \r 回车     0xa 10 \n 换行    0 \0  0 空字符  0x8 \b 8 退格
//		if(Uart_Buf[0]=='R'&&Uart_Buf[1]=='e'&&Uart_Buf[2]=='t'&&Uart_Buf[3]=='u'&&Uart_Buf[4]=='r'&&Uart_Buf[5]=='n')
//		{
//		  sprintf(Uart_Buf,"Noise:%03.1fdB",(float)Voi_Dat);
//      Uart_SendString(Uart_Buf);
//			Uart_Num=0;//使得判断下一次也有效
//		}
//}
//}
//void uart_0(void) interrupt 4//收字符串
//{
//  if(RI)
//  {
//    Uart_Buf[Uart_Num++] = SBUF;
//    RI = 0;
//  }
//}
//=====================================串口通信模块==============================
void TimerT1() interrupt 3
{
	ulms++;
//=======================================显示选中闪烁================================================
	//计数0.8s闪烁
//  if(model==1){if(++C_light==1600){C_light=0;}}
//=======================================显示选中闪烁================================================
//========================================温度模块================================================
//	if(ulms>750)
//	{		
//========================================温度模块================================================
	if(++S_Dly== 500) S_Dly = 0;//半秒更新一次数码管
  if(++K_Dly== 10)K_Dly = 0;//按键消抖
	Seg_Disp(S_C, S_P);//动态扫描
  if(++S_P == 8) S_P = 0;
	Led_Disp(Led_V);
//========================================温度模块================================================
//	}	//温度模块预读取，让0.75秒后在进行数码管显示来读取第一次。
//========================================温度模块================================================
//=======================================频率模块=======================================
//	  if(!(ulms % 1000))  555频率计数专用，1秒钟收到多少个脉冲频率就是多少
//  {
//    uiFre_Val = (TH0<<8)+TL0;
//    TH0 = 0;
//    TL0 = 0;
//  }
//=======================================频率模块=======================================
}
//void PCAServer() interrupt 7
//{
//	
////	CH = 0xFC;//溢出
////	CL = 0x18;
//	
//	CH = 0;//捕获
//	CL = 0;
//    
//	if(++Key_Slow_Down == 10) Key_Slow_Down = 0;
//	if(++Seg_Slow_Down == 200) Seg_Slow_Down = 0;
//	if(++Seg_Pos == 8) Seg_Pos = 0;
//	
//	Seg_Disp(Seg_Pos,Seg_Buf[Seg_Pos],Seg_Point[Seg_Pos]);
//	Led_Disp(Seg_Pos,ucLed[Seg_Pos]);
//	CCF0 = 0;//捕获
////	CF = 0;//溢出
//}

void main()
{
	 Cls_p();
	 Timer1Init();
	 UartInit();
//========================================ds1302时钟模块=================================	
//Set_RTC(pucRtc);
//========================================ds1302时钟模块=================================
//========================================温度模块================================================
//temp = Read_Tem();预读取防止温度读取时是85
//========================================温度模块================================================
//========================================EEPROM==================================================
//	 EEPROM_Read(S_B,0,2);
//	 Cha_Cou=(S_B[0]<<8)+S_B[1];
//========================================EEPROM==================================================
   while(1)
	 {
	   Key_Proceed();
	   Seg_Proceed();
	   Led_Proceed();
		 //  Uart_Proc();		// 为了便于在线调试，可以在其他功能调通后再加入UART处理
	 }
}